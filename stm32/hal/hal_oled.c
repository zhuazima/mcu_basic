#include "hal_oled.h"
#include "stm32f10x.h"






const unsigned char asc2_0806[][6] =
{
{0x00, 0x00, 0x00, 0x00, 0x00, 0x00},// sp
{0x00, 0x00, 0x00, 0x2f, 0x00, 0x00},// !
{0x00, 0x00, 0x07, 0x00, 0x07, 0x00},// "
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{0x14, 0x14, 0x14, 0x14, 0x14, 0x14},// horiz lines
};
//12*12 ASCII?????
const unsigned char asc2_1206[95][12]={
{0x00,0x00,0x00,0x00,0x00,0x00,0x00,0x00,0x00,0x00,0x00,0x00},/*" ",0*/
{0x00,0x00,0xFC,0x00,0x00,0x00,0x00,0x00,0x02,0x00,0x00,0x00},/*"!",1*/
{0x00,0x0C,0x02,0x0C,0x02,0x00,0x00,0x00,0x00,0x00,0x00,0x00},/*""",2*/
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{0x02,0x01,0x02,0x04,0x04,0x02,0x00,0x00,0x00,0x00,0x00,0x00},/*"~",94*/
};  
//16*16 ASCII?????
const unsigned char asc2_1608[][16]={	  
{0x00,0x00,0x00,0x00,0x00,0x00,0x00,0x00,0x00,0x00,0x00,0x00,0x00,0x00,0x00,0x00},/*" ",0*/
{0x00,0x00,0x00,0xF8,0x00,0x00,0x00,0x00,0x00,0x00,0x00,0x33,0x30,0x00,0x00,0x00},/*"!",1*/
{0x00,0x10,0x0C,0x06,0x10,0x0C,0x06,0x00,0x00,0x00,0x00,0x00,0x00,0x00,0x00,0x00},/*""",2*/
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{0x00,0x06,0x01,0x01,0x02,0x02,0x04,0x04,0x00,0x00,0x00,0x00,0x00,0x00,0x00,0x00},/*"~",94*/
};  
//24*24 ASICII?????
const unsigned char asc2_2412[][36]={	  
{0x00,0x00,0x00,0x00,0x00,0x00,0x00,0x00,0x00,0x00,0x00,0x00,0x00,0x00,0x00,0x00,0x00,0x00,0x00,0x00,0x00,0x00,0x00,0x00,0x00,0x00,0x00,0x00,0x00,0x00,0x00,0x00,0x00,0x00,0x00,0x00},/*" ",0*/
{0x00,0x00,0x00,0x00,0x00,0xF0,0xF0,0xF0,0x00,0x00,0x00,0x00,0x00,0x00,0x00,0x00,0x00,0x01,0x7F,0x01,0x00,0x00,0x00,0x00,0x00,0x00,0x00,0x00,0x00,0x1C,0x1C,0x1C,0x00,0x00,0x00,0x00},/*"!",1*/
{0x00,0x00,0x80,0x60,0x30,0x1C,0x8C,0x60,0x30,0x1C,0x0C,0x00,0x00,0x00,0x00,0x00,0x00,0x00,0x00,0x00,0x00,0x00,0x00,0x00,0x00,0x00,0x00,0x00,0x00,0x00,0x00,0x00,0x00,0x00,0x00,0x00},/*""",2*/
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{0x00,0x18,0x06,0x02,0x02,0x04,0x08,0x10,0x20,0x20,0x30,0x08,0x00,0x00,0x00,0x00,0x00,0x00,0x00,0x00,0x00,0x00,0x00,0x00,0x00,0x00,0x00,0x00,0x00,0x00,0x00,0x00,0x00,0x00,0x00,0x00},/*"~",94*/



};

unsigned char OLED_GRAM[144][8];

//反显函数
void hal_Oled_ColorTurn(unsigned char i)
{
	if(i==0)
		{
			hal_Oled_WR_Byte(0xA6,OLED_CMD);//正常显示
		}
	if(i==1)
		{
			hal_Oled_WR_Byte(0xA7,OLED_CMD);//反色显示
		}
}

//屏幕旋转180度
void hal_Oled_DisplayTurn(unsigned char i)
{
	if(i==0)
		{
			hal_Oled_WR_Byte(0xC8,OLED_CMD);//正常显示
			hal_Oled_WR_Byte(0xA1,OLED_CMD);
		}
	if(i==1)
		{
			hal_Oled_WR_Byte(0xC0,OLED_CMD);//反转显示
			hal_Oled_WR_Byte(0xA0,OLED_CMD);
		}
}

static void hal_Oled_WR_Byte(unsigned char dat,unsigned char cmd)		//硬件实现SPI 模式 3
{		
	unsigned char retry=0;		
	if(cmd)
	{
		OLED_DC_Set();
	}else 
	{
		OLED_DC_Clr();		  
	}
	 
	SPI1->DR=dat;	 	  //发送一个byte 
			 
	retry=0;
 
	while((SPI1->SR & SPI_I2S_FLAG_BSY) != RESET)		//如果移植发不出去，稍微延时，防止死在这里
	{
		retry++;
		if(retry>200)
			return;
	}	  						    
 		 		  
	OLED_DC_Set();   	  
}



// static void hal_Oled_WR_Byte(unsigned char dat,unsigned char cmd)	//软件实现SPI 模式 3
// {		
// 	unsigned char i;

// 	if(cmd)
// 	{
// 		OLED_DC_Set();
// 	}else 
// 	{
// 		OLED_DC_Clr();		  
// 	}
	
// 	OLED_CS_Clr();
// 	for(i = 0;i < 8;i++)
// 	{
// 		OLED_SCL_Clr();		//SPI 模式 3 空闲时候SCL是高的状态，要先拉低
// 		if(dat & 0x80)
// 		{
// 			OLED_SDA_Set();
// 		}
// 		else
// 		{
// 			OLED_SDA_Clr();
// 		}
// 		OLED_SCL_Set();
// 		dat <<= 1;

// 	} 
// 	OLED_DC_Set();
// 	OLED_CS_Set();
// }



//清屏指定区域
//x,y：起点坐标
//sizex,sizey,长宽
 
void hal_Oled_ClearArea(unsigned char x,unsigned char y,unsigned char sizex,unsigned char sizey)
{
	unsigned char i,n,m;
	unsigned char xy=0;
	unsigned char y1;
 
	y1 = y;
	//sizey=sizey/8+((sizey%8)?1:0);	//计算一个图形y轴所占用的字节数
	xy=sizey/8;
	 
	for(n=0;n<xy;n++)
	{
		for(i=0; i<sizex; i++)
		{
			for(m=0; m<8; m++)
			{
				hal_Oled_DrawPoint(x+i,y1+m,0);
			}
		}
		//一行数据传输完毕
		y1 = y1+8;
	}
	
	xy=sizey%8;
	for(i=0; i<sizex; i++)
	{
		for(m=0; m<xy; m++)
		{
			hal_Oled_DrawPoint(x+i,y1+m,0);
		}
	}
	
	
}
//开启OLED显示 
void hal_Oled_DisPlay_On(void)
{
	hal_Oled_WR_Byte(0x8D,OLED_CMD);//电荷泵使能
	hal_Oled_WR_Byte(0x14,OLED_CMD);//开启电荷泵
	hal_Oled_WR_Byte(0xAF,OLED_CMD);//点亮屏幕
}

//关闭OLED显示 
void hal_Oled_DisPlay_Off(void)
{
	hal_Oled_WR_Byte(0x8D,OLED_CMD);//电荷泵使能
	hal_Oled_WR_Byte(0x10,OLED_CMD);//关闭电荷泵
	hal_Oled_WR_Byte(0xAE,OLED_CMD);//关闭屏幕
}

//更新显存到OLED	
void hal_Oled_Refresh(void)
{
	unsigned char i,n;
	for(i=0;i<8;i++)
	{
	   hal_Oled_WR_Byte(0xb0+i,OLED_CMD); //设置行起始地址
	   hal_Oled_WR_Byte(0x00,OLED_CMD);   //设置低列起始地址
	   hal_Oled_WR_Byte(0x10,OLED_CMD);   //设置高列起始地址
	   for(n=0;n<128;n++)
		 hal_Oled_WR_Byte(OLED_GRAM[n][i],OLED_DATA);
  }
}
//清屏函数
void hal_Oled_Clear(void)
{
	unsigned char i,n;
	for(i=0;i<8;i++)
	{
	   for(n=0;n<128;n++)
			{
			 OLED_GRAM[n][i]=0;//清除所有数据
			}
  }
	hal_Oled_Refresh();//更新显示
}

//画点 
//x:0~127
//y:0~63
//t:1 填充 0,清空	
void hal_Oled_DrawPoint(unsigned char x,unsigned char y,unsigned char t)
{
	unsigned char i,m,n;
	i=y/8;
	m=y%8;
	n=1<<m;
	if(t){OLED_GRAM[x][i]|=n;}
	else
	{
		OLED_GRAM[x][i]=~OLED_GRAM[x][i];
		OLED_GRAM[x][i]|=n;
		OLED_GRAM[x][i]=~OLED_GRAM[x][i];
	}
}

//画线
//x1,y1:起点坐标
//x2,y2:结束坐标
void hal_Oled_DrawLine(unsigned char x1,unsigned char y1,unsigned char x2,unsigned char y2,unsigned char mode)
{
	unsigned short t; 
	int xerr=0,yerr=0,delta_x,delta_y,distance;
	int incx,incy,uRow,uCol;
	delta_x=x2-x1; //计算坐标增量 
	delta_y=y2-y1;
	uRow=x1;//画线起点坐标
	uCol=y1;
	if(delta_x>0)
	{
		incx=1; //设置单步方向 
	}else if(delta_x==0)
	{
		incx=0;//垂直线 
	}else 
	{
		incx=-1;
		delta_x=-delta_x;
	}
	if(delta_y>0)
	{
		incy=1;
	}else if(delta_y==0)
	{
		incy=0;//水平线 
	}else 
	{
		incy=-1;
		delta_y=-delta_x;
	}
	if(delta_x>delta_y)
	{
		distance=delta_x; //选取基本增量坐标轴 
	}else 
	{
		distance=delta_y;
	}
	for(t=0;t<distance+1;t++)
	{
		hal_Oled_DrawPoint(uRow,uCol,mode);//画点
		xerr+=delta_x;
		yerr+=delta_y;
		if(xerr>distance)
		{
			xerr-=distance;
			uRow+=incx;
		}
		if(yerr>distance)
		{
			yerr-=distance;
			uCol+=incy;
		}
	}
}
//x,y:圆心坐标
//r:圆的半径
void hal_Oled_DrawCircle(unsigned char x,unsigned char y,unsigned char r)
{
	int a, b,num;
    a = 0;
    b = r;
    while(2 * b * b >= r * r)      
    {
        hal_Oled_DrawPoint(x + a, y - b,1);
        hal_Oled_DrawPoint(x - a, y - b,1);
        hal_Oled_DrawPoint(x - a, y + b,1);
        hal_Oled_DrawPoint(x + a, y + b,1);
 
        hal_Oled_DrawPoint(x + b, y + a,1);
        hal_Oled_DrawPoint(x + b, y - a,1);
        hal_Oled_DrawPoint(x - b, y - a,1);
        hal_Oled_DrawPoint(x - b, y + a,1);
        
        a++;
        num = (a * a + b * b) - r*r;//计算画的点离圆心的距离
        if(num > 0)
        {
            b--;
            a--;
        }
    }
}



//在指定位置显示一个字符,包括部分字符
//x:0~127
//y:0~63
//size1:选择字体 6x8/6x12/8x16/12x24
//mode:0,反色显示;1,正常显示
void hal_Oled_ShowChar(unsigned char x,unsigned char y,unsigned char chr,unsigned char size1,unsigned char mode)
{
	unsigned char i,m,temp,size2,chr1;
	unsigned char x0=x,y0=y;
	if(size1==8)size2=6;
	else size2=(size1/8+((size1%8)?1:0))*(size1/2);  //得到字体一个字符对应点阵集所占的字节数
	chr1=chr-' ';  //计算偏移后的值
	for(i=0;i<size2;i++)
	{
		if(size1==8)
		{
			temp=asc2_0806[chr1][i];	//调用0806字体
		}else if(size1==12)
        {
			temp=asc2_1206[chr1][i];	//调用1206字体
		}else if(size1==16)
        {
			temp=asc2_1608[chr1][i];	 //调用1608字体
		}else if(size1==24)
        { 
			temp=asc2_2412[chr1][i];	//调用2412字体
		} 
		else 
		{
			return;
		}
		for(m=0;m<8;m++)
		{
			if(temp&0x01)
			{
				hal_Oled_DrawPoint(x,y,mode);
			}else 
			{
				hal_Oled_DrawPoint(x,y,!mode);
			}
			temp>>=1;
			y++;	//因为是纵向扫描，所以每画一个点，纵坐标+1
		
		}
		x++;		//一个字节画完,纵坐标+1，开始下一列数据扫描
		if((size1!=8)&&((x-x0)==size1/2))	//判断一个字符x坐标的数据是否全部画完
		{
		//size1!=8是因为8*6大小的字符只需要扫描一次，x-x0代表计算当前扫描的x轴位置，size1/2是字符是x/y=2的比例(8*6大小除外)
		//比如12*6,24*12,都是2:1的比例，那sizel/2就可以计算出一个字符需要扫描多少次x
			x=x0;y0=y0+8;
		}
		y=y0;
  }
}


//显示字符串
//x,y:起点坐标  
//size1:字体大小 
//*chr:字符串起始地址 
//mode:0,反色显示;1,正常显示
void hal_Oled_ShowString(unsigned char x,unsigned char y,unsigned char *chr,unsigned char size1,unsigned char mode)
{
	while((*chr>=' ')&&(*chr<='~'))//判断是不是非法字符!
	{
		hal_Oled_ShowChar(x,y,*chr,size1,mode);
		if(size1==8)x+=6;
		else x+=size1/2;
		chr++;
  }
}

//m^n
unsigned int hal_Oled_Pow(unsigned char m,unsigned char n)
{
	unsigned int result=1;
	while(n--)
	{
	  result*=m;
	}
	return result;
}

//显示数字
//x,y :起点坐标
//num :要显示的数字
//len :数字的位数
//size:字体大小
//mode:0,反色显示;1,正常显示
void hal_Oled_ShowNum(unsigned char x,unsigned char y,unsigned int num,unsigned char len,unsigned char size1,unsigned char mode)
{
	unsigned char t,temp,m=0;
	if(size1==8)m=2;
	for(t=0;t<len;t++)
	{
		temp=(num/hal_Oled_Pow(10,len-t-1))%10;
			if(temp==0)
			{
				hal_Oled_ShowChar(x+(size1/2+m)*t,y,'0',size1,mode);
      }
			else 
			{
			  hal_Oled_ShowChar(x+(size1/2+m)*t,y,temp+'0',size1,mode);
			}
  }
}






static void hal_OledConfig(void)
{
 
	SPI_InitTypeDef  SPI_InitStructure;
	GPIO_InitTypeDef GPIO_InitStructure;
	
	/* Enable SPI1 and GPIOA clocks */
	RCC_APB2PeriphClockCmd(RCC_APB2Periph_SPI1, ENABLE);
	RCC_APB2PeriphClockCmd(RCC_APB2Periph_GPIOA, ENABLE);	
	RCC_APB2PeriphClockCmd(RCC_APB2Periph_AFIO, ENABLE);			//复用功能使能
	
	/* Configure SPI1 pins: SCK, MOSI */
	GPIO_InitStructure.GPIO_Pin =  OLED_CLK_PIN | OLED_SDA_PIN;
	GPIO_InitStructure.GPIO_Speed = GPIO_Speed_50MHz;
	GPIO_InitStructure.GPIO_Mode = GPIO_Mode_AF_PP;
	GPIO_Init(GPIOA, &GPIO_InitStructure);
	
	//OLED复位引脚
	GPIO_InitStructure.GPIO_Pin = OLED_RES_PIN;
	GPIO_InitStructure.GPIO_Speed = GPIO_Speed_50MHz;
	GPIO_InitStructure.GPIO_Mode = GPIO_Mode_Out_PP;
	GPIO_Init(GPIOA, &GPIO_InitStructure);
	GPIO_SetBits(GPIOA,OLED_RES_PIN);
	
	//OLED命令/数据控制引脚
	GPIO_InitStructure.GPIO_Pin = OLED_DC_PIN;
	GPIO_InitStructure.GPIO_Speed = GPIO_Speed_50MHz;
	GPIO_InitStructure.GPIO_Mode = GPIO_Mode_Out_PP;
	GPIO_Init(GPIOA, &GPIO_InitStructure);
	GPIO_SetBits(GPIOA,OLED_DC_PIN);
	
	/* SPI1 configuration */ 
	SPI_InitStructure.SPI_Direction = SPI_Direction_1Line_Tx; //SPI1设置为两线全双工
	SPI_InitStructure.SPI_Mode = SPI_Mode_Master;	                     //设置SPI1为主模式
	SPI_InitStructure.SPI_DataSize = SPI_DataSize_8b;                  //SPI发送接收8位帧结构
	SPI_InitStructure.SPI_CPOL = SPI_CPOL_High;	 		                   //串行时钟在不操作时，时钟为高电平
	SPI_InitStructure.SPI_CPHA = SPI_CPHA_2Edge;		                   //第二个时钟沿开始采样数据
	SPI_InitStructure.SPI_NSS = SPI_NSS_Soft;			                     //NSS信号由软件（使用SSI位）管理
	SPI_InitStructure.SPI_BaudRatePrescaler = SPI_BaudRatePrescaler_8; //定义波特率预分频的值:波特率预分频值为8
	SPI_InitStructure.SPI_FirstBit = SPI_FirstBit_MSB;				         //数据传输从MSB位开始
	SPI_InitStructure.SPI_CRCPolynomial = 7;						               //CRC值计算的多项式
	SPI_Init(SPI1, &SPI_InitStructure);
	/* Enable SPI1  */
	SPI_Cmd(SPI1, ENABLE); 											  //使能SPI2外设
	
 
	
}


static void hal_Oled_Delay(unsigned short t)
{
	unsigned short i,j,k;
	j = t;
	for(i=0; i<j; i++);
	{
		for(k=0; k<1000; k++);
	}
}


//OLED的初始化
void hal_Oled_Init(void)
{
	hal_OledConfig();

	OLED_RES_Clr();
	hal_Oled_Delay(20);
	OLED_RES_Set();
	
	hal_Oled_WR_Byte(0xAE,OLED_CMD);//--turn off oled panel
	hal_Oled_WR_Byte(0x00,OLED_CMD);//---set low column address
	hal_Oled_WR_Byte(0x10,OLED_CMD);//---set high column address
	hal_Oled_WR_Byte(0x40,OLED_CMD);//--set start line address  Set Mapping RAM Display Start Line (0x00~0x3F)
	hal_Oled_WR_Byte(0x81,OLED_CMD);//--set contrast control register
	hal_Oled_WR_Byte(0xCF,OLED_CMD);// Set SEG Output Current Brightness
	hal_Oled_WR_Byte(0xA1,OLED_CMD);//--Set SEG/Column Mapping     0xa0左右反置 0xa1正常
	hal_Oled_WR_Byte(0xC8,OLED_CMD);//Set COM/Row Scan Direction   0xc0上下反置 0xc8正常
	hal_Oled_WR_Byte(0xA6,OLED_CMD);//--set normal display
	hal_Oled_WR_Byte(0xA8,OLED_CMD);//--set multiplex ratio(1 to 64)
	hal_Oled_WR_Byte(0x3f,OLED_CMD);//--1/64 duty
	hal_Oled_WR_Byte(0xD3,OLED_CMD);//-set display offset	Shift Mapping RAM Counter (0x00~0x3F)
	hal_Oled_WR_Byte(0x00,OLED_CMD);//-not offset
	hal_Oled_WR_Byte(0xd5,OLED_CMD);//--set display clock divide ratio/oscillator frequency
	hal_Oled_WR_Byte(0x80,OLED_CMD);//--set divide ratio, Set Clock as 100 Frames/Sec
	hal_Oled_WR_Byte(0xD9,OLED_CMD);//--set pre-charge period
	hal_Oled_WR_Byte(0xF1,OLED_CMD);//Set Pre-Charge as 15 Clocks & Discharge as 1 Clock
	hal_Oled_WR_Byte(0xDA,OLED_CMD);//--set com pins hardware configuration
	hal_Oled_WR_Byte(0x12,OLED_CMD);
	hal_Oled_WR_Byte(0xDB,OLED_CMD);//--set vcomh
	hal_Oled_WR_Byte(0x40,OLED_CMD);//Set VCOM Deselect Level
	hal_Oled_WR_Byte(0x20,OLED_CMD);//-Set Page Addressing Mode (0x00/0x01/0x02)
	hal_Oled_WR_Byte(0x02,OLED_CMD);//
	hal_Oled_WR_Byte(0x8D,OLED_CMD);//--set Charge Pump enable/disable
	hal_Oled_WR_Byte(0x14,OLED_CMD);//--set(0x10) disable
	hal_Oled_WR_Byte(0xA4,OLED_CMD);// Disable Entire Display On (0xa4/0xa5)
	hal_Oled_WR_Byte(0xA6,OLED_CMD);// Disable Inverse Display On (0xa6/a7) 
	hal_Oled_Clear();
	hal_Oled_WR_Byte(0xAF,OLED_CMD);


}



